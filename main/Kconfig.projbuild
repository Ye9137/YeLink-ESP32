## main/Kconfig.projbuild
```kconfig
# Copyright (c) 2026 Ye；不同模块和杜邦线可选择不同传输频率。
menu "Ye display"
config YE_LCD_SPI_MHZ
    int "ST7735 SPI clock (MHz)"
    range 1 80
    default 27
    help
        Requested SPI clock. Hardware may round to a supported divider.
        ESP32 supports up to 80 MHz; the attached panel and wiring may not.
        If pixels corrupt on long wires, try 20 or 10 MHz.
config YE_LCD_TARGET_FPS
    int "Animation target FPS"
    range 10 100
    default 60
    help
        Animation scheduling target, not a measured panel refresh rate.
endmenu

menu "Ye Wi-Fi sharing"
config YE_ROUTER_TCP_MSS
    int "Maximum forwarded TCP MSS"
    range 536 1460
    default 1360
    help
        Clamp existing MSS options in IPv4 SYN/SYN-ACK to reduce path-MTU stalls.
        This does not change the MTU or datagram size of a UDP VPN transport.
config YE_NAPT_UDP_TIMEOUT_SECONDS
    int "UDP NAT idle timeout (seconds)"
    range 10 600
    default 120
    help
        Keep idle UDP mappings for proxy/VPN transports. The SDK default is 2s.
        Longer timeouts retain more mappings; check the NAPT capacity counters.
config YE_NAPT_CAPACITY
    int "Maximum shared IPv4 connections"
    range 128 1024
    default 512
    help
        NAPT shares TCP/UDP/ICMP mappings between all hotspot clients.
        A full table can evict an established TCP connection and send RST.
        512 entries use about 8 KiB more RAM than the earlier 256-entry limit.
config YE_NAPT_TCP_TRANSIENT_SECONDS
    int "TCP unfinished/closed NAT idle timeout (seconds)"
    range 5 120
    default 15
    help
        Reclaim idle handshakes, reset connections and fully acknowledged FIN
        connections sooner than the SDK default TCP_MSL (60s).
        Established active TCP connections keep the original 30-minute idle timeout.
config YE_WIFI_HT40
    bool "Allow 40 MHz Wi-Fi bandwidth"
    default y
    help
        Allow HT40 on station and SoftAP, retaining 802.11b/g/n compatibility.
        Actual bandwidth depends on peer negotiation and the upstream channel.
        Disable this option to use HT20 in crowded 2.4 GHz environments.
endmenu
```

## sdkconfig.defaults
```kconfig
# Copyright (c) 2026 Ye；新生成配置时启用 HTTPS 及扩大的应用分区。
CONFIG_PARTITION_TABLE_CUSTOM=y
CONFIG_PARTITION_TABLE_CUSTOM_FILENAME="partitions.csv"
CONFIG_MBEDTLS_CERTIFICATE_BUNDLE=y
CONFIG_MBEDTLS_CERTIFICATE_BUNDLE_DEFAULT_FULL=y
CONFIG_ESP_HTTP_CLIENT_ENABLE_HTTPS=y
# 热点通过 STA 共享 IPv4；不开放端口映射，DNS 和后台连接预留套接字。
CONFIG_LWIP_IP_FORWARD=y
CONFIG_LWIP_IPV4_NAPT=y
CONFIG_LWIP_IPV4_NAPT_PORTMAP=n
CONFIG_LWIP_MAX_SOCKETS=16
# 按用户要求提升至 240 MHz；保留 -O2，保护和复位诊断继续启用。
CONFIG_ESP_DEFAULT_CPU_FREQ_MHZ_240=y
CONFIG_COMPILER_OPTIMIZATION_PERF=y
# 保留 802.11n 聚合，缓冲及聚合窗口恢复驱动默认值。
CONFIG_ESP_WIFI_AMPDU_TX_ENABLED=y
CONFIG_ESP_WIFI_AMPDU_RX_ENABLED=y
CONFIG_YE_WIFI_HT40=y
# CONFIG_ESP_DEFAULT_CPU_FREQ_MHZ_160 is not set
# 版本 11 吞吐回退后撤销额外复制及队列扩容，等待对照测速。
# CONFIG_LWIP_L2_TO_L3_COPY is not set
CONFIG_LWIP_TCPIP_RECVMBOX_SIZE=32
# CPU 使用率使用空闲任务的微秒计数差值，每秒采样。
CONFIG_FREERTOS_GENERATE_RUN_TIME_STATS=y
CONFIG_FREERTOS_RUN_TIME_STATS_USING_ESP_TIMER=y
# CONFIG_FREERTOS_RUN_TIME_STATS_USING_CPU_CLK is not set
CONFIG_FREERTOS_RUN_TIME_COUNTER_TYPE_U32=y
# CONFIG_FREERTOS_RUN_TIME_COUNTER_TYPE_U64 is not set

CONFIG_ESP_WIFI_TASK_PINNED_TO_CORE_0=y

# CONFIG_ESP_WIFI_TASK_PINNED_TO_CORE_1 is not set

# CONFIG_LWIP_TCPIP_TASK_AFFINITY_NO_AFFINITY is not set

# CONFIG_LWIP_TCPIP_TASK_AFFINITY_CPU0 is not set

CONFIG_LWIP_TCPIP_TASK_AFFINITY_CPU1=y

# CONFIG_FREERTOS_UNICORE is not set

CONFIG_YE_NAPT_CAPACITY=512

CONFIG_LWIP_STATS=y

CONFIG_YE_NAPT_UDP_TIMEOUT_SECONDS=120

CONFIG_LWIP_IP4_REASSEMBLY=y

CONFIG_LWIP_IP4_FRAG=y

CONFIG_LWIP_IP_REASS_MAX_PBUFS=10

# Place common lwIP RX/TX functions in IRAM (about 10 KiB per SDK help).
CONFIG_LWIP_IRAM_OPTIMIZATION=y

CONFIG_YE_ROUTER_TCP_MSS=1360

CONFIG_YE_NAPT_TCP_TRANSIENT_SECONDS=15
```
